/ {
    chosen {
        zmk,pointing = &joystick;
    };
};

&adc {
    joystick: joystick {
        compatible = "zmk,pointing-adc";
        label = "JOYSTICK";

        x-input = <&adc 0>; /* A0 / P0.02 */
        y-input = <&adc 1>; /* A1 / P0.03 */

        invert-x;
        invert-y;

        resolution = <10>;
    };
};
